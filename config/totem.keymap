/*
 * Copyright (c) 2022 The ZMK Contributors
 *
 * SPDX-License-Identifier: MIT
 */

#include <behaviors.dtsi>
#include <dt-bindings/zmk/keys.h>
#include <dt-bindings/zmk/bt.h>

#include "miryoku/miryoku.h"

/ {
    keymap {
        compatible = "zmk,keymap";
    };

    chosen {
        zmk,matrix_transform = &default_transform;
    };
};