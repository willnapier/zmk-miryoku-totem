## config/boards/shields/totem/Kconfig.shield
```kconfig
# Copyright (c) 2024 The ZMK Contributors
# SPDX-License-Identifier: MIT

config SHIELD_TOTEM_LEFT
    bool "Totem left half"

config SHIELD_TOTEM_RIGHT
    bool "Totem right half"
```
