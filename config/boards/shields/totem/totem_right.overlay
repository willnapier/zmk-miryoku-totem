/*
 * Copyright (c) 2022 The ZMK Contributors
 *
 * SPDX-License-Identifier: MIT
 */

#include "totem.dtsi" // Make sure totem.dtsi is in the same directory

&default_transform {
    // This offset ensures the right half's columns (0-4) are mapped
    // to logical columns 5-9 in the combined keymap.
    col-offset = <5>;
};

&kscan0 {
    compatible = "zmk,kscan-gpio-matrix";
    wakeup-source; // Recommended for split keyboards

    // Note: Column pins are mirrored compared to the left half
    col-gpios
        = <&xiao_d 8 GPIO_ACTIVE_HIGH>  // Col 0 (maps to logical Col 5)
        , <&xiao_d 9 GPIO_ACTIVE_HIGH>  // Col 1 (maps to logical Col 6)
        , <&xiao_d 10 GPIO_ACTIVE_HIGH> // Col 2 (maps to logical Col 7)
        , <&xiao_d 5 GPIO_ACTIVE_HIGH>  // Col 3 (maps to logical Col 8)
        , <&xiao_d 4 GPIO_ACTIVE_HIGH>  // Col 4 (maps to logical Col 9)
        ;

    // Row pins are usually the same on both halves for this type of split
    row-gpios
        = <&xiao_d 0 (GPIO_ACTIVE_HIGH | GPIO_PULL_DOWN)> // Row 0
        , <&xiao_d 1 (GPIO_ACTIVE_HIGH | GPIO_PULL_DOWN)> // Row 1
        , <&xiao_d 2 (GPIO_ACTIVE_HIGH | GPIO_PULL_DOWN)> // Row 2
        , <&xiao_d 3 (GPIO_ACTIVE_HIGH | GPIO_PULL_DOWN)> // Row 3
        ;
};
